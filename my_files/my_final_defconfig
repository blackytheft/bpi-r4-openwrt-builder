## my_files/my_final_defconfig
```kconfig
CONFIG_TARGET_mediatek=y
CONFIG_TARGET_mediatek_filogic=y
CONFIG_TARGET_mediatek_filogic_DEVICE_bananapi_bpi-r4=y
CONFIG_BUSYBOX_CUSTOM=y
CONFIG_BUSYBOX_CONFIG_BASE64=y
CONFIG_BUSYBOX_CONFIG_CKSUM=y
CONFIG_BUSYBOX_CONFIG_DIFF=y
CONFIG_BUSYBOX_CONFIG_FDISK=y
CONFIG_BUSYBOX_CONFIG_FEATURE_STAT_FORMAT=y
CONFIG_BUSYBOX_CONFIG_NOHUP=y
CONFIG_BUSYBOX_CONFIG_STAT=y
CONFIG_BUSYBOX_CONFIG_TIMEOUT=y
CONFIG_GNUTLS_ALPN=y
CONFIG_GNUTLS_ANON=y
CONFIG_GNUTLS_DTLS_SRTP=y
CONFIG_GNUTLS_HEARTBEAT=y
CONFIG_GNUTLS_OCSP=y
CONFIG_GNUTLS_PSK=y
CONFIG_KEEPALIVED_CHECKSUM_COMPAT=y
CONFIG_KEEPALIVED_FWMARK=y
CONFIG_KEEPALIVED_IP6TABLES=y
CONFIG_KEEPALIVED_IPTABLES=y
CONFIG_KEEPALIVED_LINKBEAT=y
CONFIG_KEEPALIVED_LVS=y
CONFIG_KEEPALIVED_LVS_64BIT_STATS=y
CONFIG_KEEPALIVED_LVS_SYNCD=y
CONFIG_KEEPALIVED_NFTABLES=y
CONFIG_KEEPALIVED_ROUTES=y
CONFIG_KEEPALIVED_SHA1=y
CONFIG_KEEPALIVED_VRRP=y
CONFIG_KEEPALIVED_VRRP_AUTH=y
CONFIG_KERNEL_ZRAM_BACKEND_FORCE_LZO=y
CONFIG_KERNEL_ZRAM_BACKEND_LZO=y
CONFIG_KERNEL_ZRAM_DEF_COMP_LZO=y
CONFIG_LIBCURL_COOKIES=y
CONFIG_LIBCURL_FILE=y
CONFIG_LIBCURL_FTP=y
CONFIG_LIBCURL_HTTP=y
CONFIG_LIBCURL_HTTP2=y
CONFIG_LIBCURL_MBEDTLS=y
CONFIG_LIBCURL_NO_SMB="!"
CONFIG_LIBCURL_PROXY=y
CONFIG_LIBCURL_UNIX_SOCKETS=y
CONFIG_LIBIIO_LOCAL_BACKEND=y
CONFIG_LIBIIO_NETWORK_BACKEND=y
CONFIG_LIBIIO_XML_BACKEND=y
CONFIG_LIBQMI_COLLECTION_BASIC=y
CONFIG_LIBQMI_WITH_MBIM_QMUX=y
CONFIG_LIBQMI_WITH_QRTR_GLIB=y
CONFIG_MODEMMANAGER_WITH_MBIM=y
CONFIG_MODEMMANAGER_WITH_NETIFD=y
CONFIG_MODEMMANAGER_WITH_QMI=y
CONFIG_MODEMMANAGER_WITH_QRTR=y
CONFIG_OPENLDAP_DEBUG=y
CONFIG_OPENSSL_ENGINE=y
CONFIG_OPENSSL_WITH_ASM=y
CONFIG_OPENSSL_WITH_CHACHA_POLY1305=y
CONFIG_OPENSSL_WITH_CMS=y
CONFIG_OPENSSL_WITH_DEPRECATED=y
CONFIG_OPENSSL_WITH_ERROR_MESSAGES=y
CONFIG_OPENSSL_WITH_IDEA=y
CONFIG_OPENSSL_WITH_MDC2=y
CONFIG_OPENSSL_WITH_PSK=y
CONFIG_OPENSSL_WITH_SEED=y
CONFIG_OPENSSL_WITH_SRP=y
CONFIG_OPENSSL_WITH_TLS13=y
CONFIG_OPENSSL_WITH_WHIRLPOOL=y
CONFIG_PACKAGE_CFG80211_TESTMODE=y
CONFIG_PACKAGE_acl=m
CONFIG_PACKAGE_adguardhome=y
CONFIG_PACKAGE_aeonsemi-as21xxx-firmware=y
CONFIG_PACKAGE_airoha-en8811h-firmware=y
CONFIG_PACKAGE_attr=m
CONFIG_PACKAGE_avahi-dbus-daemon=y
CONFIG_PACKAGE_bash=y
CONFIG_PACKAGE_blkid=y
CONFIG_PACKAGE_block-mount=y
CONFIG_PACKAGE_blockd=y
CONFIG_PACKAGE_bridge=y
CONFIG_PACKAGE_btrfs-progs=y
CONFIG_PACKAGE_ca-bundle=y
CONFIG_PACKAGE_ca-certificates=y
CONFIG_PACKAGE_cfdisk=y
CONFIG_PACKAGE_cgi-io=y
CONFIG_PACKAGE_chat=y
CONFIG_PACKAGE_collectd=y
CONFIG_PACKAGE_collectd-mod-cpu=y
CONFIG_PACKAGE_collectd-mod-interface=y
CONFIG_PACKAGE_collectd-mod-iwinfo=y
CONFIG_PACKAGE_collectd-mod-load=y
CONFIG_PACKAGE_collectd-mod-memory=y
CONFIG_PACKAGE_collectd-mod-network=y
CONFIG_PACKAGE_collectd-mod-rrdtool=y
CONFIG_PACKAGE_comgt=m
CONFIG_PACKAGE_containerd=m
CONFIG_PACKAGE_davici=y
CONFIG_PACKAGE_dawn=y
CONFIG_PACKAGE_dbus=y
CONFIG_PACKAGE_ddns-scripts=y
CONFIG_PACKAGE_ddns-scripts-services=y
CONFIG_PACKAGE_dnsmasq-full=y
CONFIG_PACKAGE_dnsmasq_full_auth=y
CONFIG_PACKAGE_dnsmasq_full_conntrack=y
CONFIG_PACKAGE_dnsmasq_full_dhcp=y
CONFIG_PACKAGE_dnsmasq_full_dhcpv6=y
CONFIG_PACKAGE_dnsmasq_full_dnssec=y
CONFIG_PACKAGE_dnsmasq_full_ipset=y
CONFIG_PACKAGE_dnsmasq_full_nftset=y
CONFIG_PACKAGE_dnsmasq_full_noid=y
CONFIG_PACKAGE_dnsmasq_full_tftp=y
CONFIG_PACKAGE_docker=m
CONFIG_PACKAGE_docker-compose=m
CONFIG_PACKAGE_dockerd=m
CONFIG_PACKAGE_ethtool-full=y
CONFIG_PACKAGE_fdisk=y
CONFIG_PACKAGE_fio=y
CONFIG_PACKAGE_gdisk=y
CONFIG_PACKAGE_glib2=y
CONFIG_PACKAGE_gpioctl-sysfs=y
CONFIG_PACKAGE_gpiod-tools=y
CONFIG_PACKAGE_i2c-tools=y
CONFIG_PACKAGE_iconv=y
CONFIG_PACKAGE_icu=y
CONFIG_PACKAGE_iio-utils=y
CONFIG_PACKAGE_initramfs-upgrade-fw=y
CONFIG_PACKAGE_ip-bridge=y
CONFIG_PACKAGE_ip-full=y
CONFIG_PACKAGE_ip6tables-extra=y
CONFIG_PACKAGE_ip6tables-mod-nat=y
CONFIG_PACKAGE_ip6tables-nft=y
CONFIG_PACKAGE_iperf=y
CONFIG_PACKAGE_iperf3=y
CONFIG_PACKAGE_ipset=y
CONFIG_PACKAGE_iptables-mod-conntrack-extra=y
CONFIG_PACKAGE_iptables-mod-extra=y
CONFIG_PACKAGE_iptables-mod-ipopt=y
CONFIG_PACKAGE_iptables-nft=y
CONFIG_PACKAGE_iw-full=y
CONFIG_PACKAGE_iwinfo=y
CONFIG_PACKAGE_keepalived=y
CONFIG_PACKAGE_kmod-asn1-decoder=y
CONFIG_PACKAGE_kmod-ata-core=y
CONFIG_PACKAGE_kmod-br-netfilter=y
CONFIG_PACKAGE_kmod-crypto-acompress=y
CONFIG_PACKAGE_kmod-crypto-arc4=y
CONFIG_PACKAGE_kmod-crypto-blake2b=y
CONFIG_PACKAGE_kmod-crypto-cbc=y
CONFIG_PACKAGE_kmod-crypto-crc32=y
CONFIG_PACKAGE_kmod-crypto-deflate=y
CONFIG_PACKAGE_kmod-crypto-ecb=y
CONFIG_PACKAGE_kmod-crypto-echainiv=y
CONFIG_PACKAGE_kmod-crypto-kpp=y
CONFIG_PACKAGE_kmod-crypto-lib-chacha20=y
CONFIG_PACKAGE_kmod-crypto-lib-chacha20poly1305=y
CONFIG_PACKAGE_kmod-crypto-lib-curve25519=y
CONFIG_PACKAGE_kmod-crypto-lib-poly1305=y
CONFIG_PACKAGE_kmod-crypto-user=y
CONFIG_PACKAGE_kmod-crypto-xxhash=y
CONFIG_PACKAGE_kmod-dsa=y
CONFIG_PACKAGE_kmod-fixed-phy=y
CONFIG_PACKAGE_kmod-fs-autofs4=y
CONFIG_PACKAGE_kmod-fs-btrfs=y
CONFIG_PACKAGE_kmod-fs-exfat=y
CONFIG_PACKAGE_kmod-fs-exportfs=y
CONFIG_PACKAGE_kmod-fs-ext4=y
CONFIG_PACKAGE_kmod-fs-f2fs=y
CONFIG_PACKAGE_kmod-fs-ksmbd=y
CONFIG_PACKAGE_kmod-fs-netfs=y
CONFIG_PACKAGE_kmod-fs-smbfs-common=y
CONFIG_PACKAGE_kmod-fuse=y
CONFIG_PACKAGE_kmod-gpio-pca953x=y
CONFIG_PACKAGE_kmod-gpio-pcf857x=y
CONFIG_PACKAGE_kmod-gre=y
CONFIG_PACKAGE_kmod-hwmon-ina2xx=y
CONFIG_PACKAGE_kmod-i2c-algo-bit=y
CONFIG_PACKAGE_kmod-i2c-gpio=y
CONFIG_PACKAGE_kmod-i2c-mux-gpio=y
CONFIG_PACKAGE_kmod-i2c-mux-pca9541=y
CONFIG_PACKAGE_kmod-ifb=y
CONFIG_PACKAGE_kmod-ip6tables=y
CONFIG_PACKAGE_kmod-ip6tables-extra=y
CONFIG_PACKAGE_kmod-ipsec=y
CONFIG_PACKAGE_kmod-ipsec4=y
CONFIG_PACKAGE_kmod-ipsec6=y
CONFIG_PACKAGE_kmod-ipt-conntrack=y
CONFIG_PACKAGE_kmod-ipt-conntrack-extra=y
CONFIG_PACKAGE_kmod-ipt-core=y
CONFIG_PACKAGE_kmod-ipt-extra=y
CONFIG_PACKAGE_kmod-ipt-ipopt=y
CONFIG_PACKAGE_kmod-ipt-ipsec=y
CONFIG_PACKAGE_kmod-ipt-ipset=y
CONFIG_PACKAGE_kmod-ipt-nat=y
CONFIG_PACKAGE_kmod-ipt-nat-extra=y
CONFIG_PACKAGE_kmod-ipt-nat6=y
CONFIG_PACKAGE_kmod-ipt-physdev=y
CONFIG_PACKAGE_kmod-iptunnel=y
CONFIG_PACKAGE_kmod-iptunnel4=y
CONFIG_PACKAGE_kmod-iptunnel6=y
CONFIG_PACKAGE_kmod-ipvlan=y
CONFIG_PACKAGE_kmod-jool-netfilter=y
CONFIG_PACKAGE_kmod-l2tp=y
CONFIG_PACKAGE_kmod-lib-crc-itu-t=y
CONFIG_PACKAGE_kmod-lib-crc16=y
CONFIG_PACKAGE_kmod-lib-lzo=y
CONFIG_PACKAGE_kmod-lib-raid6=y
CONFIG_PACKAGE_kmod-lib-xor=y
CONFIG_PACKAGE_kmod-lib-xxhash=y
CONFIG_PACKAGE_kmod-lib-zlib-deflate=y
CONFIG_PACKAGE_kmod-lib-zlib-inflate=y
CONFIG_PACKAGE_kmod-lib-zstd=y
CONFIG_PACKAGE_kmod-macvlan=y
CONFIG_PACKAGE_kmod-mdio-devres=y
CONFIG_PACKAGE_kmod-mhi-bus=y
CONFIG_PACKAGE_kmod-mii=y
CONFIG_PACKAGE_kmod-mppe=y
CONFIG_PACKAGE_kmod-mt76=y
CONFIG_PACKAGE_kmod-mt7603=y
CONFIG_PACKAGE_kmod-mt76x02-common=y
CONFIG_PACKAGE_kmod-mt76x2=y
CONFIG_PACKAGE_kmod-mt76x2-common=y
CONFIG_PACKAGE_kmod-natflow=y
CONFIG_PACKAGE_kmod-net-selftests=y
CONFIG_PACKAGE_kmod-nf-conncount=y
CONFIG_PACKAGE_kmod-nf-conntrack-netlink=y
CONFIG_PACKAGE_kmod-nf-flow=y
CONFIG_PACKAGE_kmod-nf-ipt=y
CONFIG_PACKAGE_kmod-nf-ipt6=y
CONFIG_PACKAGE_kmod-nf-ipvs=y
CONFIG_PACKAGE_kmod-nf-nat6=y
CONFIG_PACKAGE_kmod-nft-compat=y
CONFIG_PACKAGE_kmod-nft-offload=y
CONFIG_PACKAGE_kmod-nls-cp437=y
CONFIG_PACKAGE_kmod-nls-iso8859-1=y
CONFIG_PACKAGE_kmod-nls-ucs2-utils=y
CONFIG_PACKAGE_kmod-nls-utf8=y
CONFIG_PACKAGE_kmod-nvme=y
CONFIG_PACKAGE_kmod-oid-registry=y
CONFIG_PACKAGE_kmod-phy-aeonsemi-as21xxx=y
CONFIG_PACKAGE_kmod-phy-airoha-en8811h=y
CONFIG_PACKAGE_kmod-phy-amd=y
CONFIG_PACKAGE_kmod-phy-aquantia=y
CONFIG_PACKAGE_kmod-phy-at803x=y
CONFIG_PACKAGE_kmod-phy-ax88796b=y
CONFIG_PACKAGE_kmod-phy-bcm7xxx=y
CONFIG_PACKAGE_kmod-phy-bcm84881=y
CONFIG_PACKAGE_kmod-phy-broadcom=y
CONFIG_PACKAGE_kmod-phy-intel-xway=y
CONFIG_PACKAGE_kmod-phy-marvell=y
CONFIG_PACKAGE_kmod-phy-marvell-10g=y
CONFIG_PACKAGE_kmod-phy-maxlinear=y
CONFIG_PACKAGE_kmod-phy-micrel=y
CONFIG_PACKAGE_kmod-phy-microchip=y
CONFIG_PACKAGE_kmod-phy-motorcomm=y
CONFIG_PACKAGE_kmod-phy-qca83xx=y
CONFIG_PACKAGE_kmod-phy-realtek=y
CONFIG_PACKAGE_kmod-phy-rtl8261n=y
CONFIG_PACKAGE_kmod-phy-smsc=y
CONFIG_PACKAGE_kmod-phy-vitesse=y
CONFIG_PACKAGE_kmod-phylib-broadcom=y
CONFIG_PACKAGE_kmod-phylib-qcom=y
CONFIG_PACKAGE_kmod-polynomial=y
CONFIG_PACKAGE_kmod-pppol2tp=y
CONFIG_PACKAGE_kmod-pps=y
CONFIG_PACKAGE_kmod-pptp=y
CONFIG_PACKAGE_kmod-ptp=y
CONFIG_PACKAGE_kmod-qmi-wwan-q=m
CONFIG_PACKAGE_kmod-random-core=y
CONFIG_PACKAGE_kmod-sched-cake=y
CONFIG_PACKAGE_kmod-sched-connmark=y
CONFIG_PACKAGE_kmod-sched-core=y
CONFIG_PACKAGE_kmod-scsi-core=y
CONFIG_PACKAGE_kmod-scsi-generic=y
CONFIG_PACKAGE_kmod-spi-dev=y
CONFIG_PACKAGE_kmod-swconfig=y
CONFIG_PACKAGE_kmod-switch-ar8xxx=y
CONFIG_PACKAGE_kmod-switch-ip17xx=y
CONFIG_PACKAGE_kmod-switch-rtl8306=y
CONFIG_PACKAGE_kmod-switch-rtl8366-smi=y
CONFIG_PACKAGE_kmod-switch-rtl8366rb=y
CONFIG_PACKAGE_kmod-switch-rtl8366s=y
CONFIG_PACKAGE_kmod-switch-rtl8367=y
CONFIG_PACKAGE_kmod-switch-rtl8367b=y
CONFIG_PACKAGE_kmod-tcp-bbr=y
CONFIG_PACKAGE_kmod-tun=y
CONFIG_PACKAGE_kmod-udptunnel4=y
CONFIG_PACKAGE_kmod-udptunnel6=y
CONFIG_PACKAGE_kmod-usb-net=y
CONFIG_PACKAGE_kmod-usb-net-cdc-ether=y
CONFIG_PACKAGE_kmod-usb-net-cdc-mbim=y
CONFIG_PACKAGE_kmod-usb-net-cdc-ncm=y
CONFIG_PACKAGE_kmod-usb-net-qmi-wwan=y
CONFIG_PACKAGE_kmod-usb-serial=y
CONFIG_PACKAGE_kmod-usb-serial-option=y
CONFIG_PACKAGE_kmod-usb-serial-qualcomm=y
CONFIG_PACKAGE_kmod-usb-serial-sierrawireless=y
CONFIG_PACKAGE_kmod-usb-serial-wwan=y
CONFIG_PACKAGE_kmod-usb-storage=y
CONFIG_PACKAGE_kmod-usb-storage-extras=y
CONFIG_PACKAGE_kmod-usb-storage-uas=y
CONFIG_PACKAGE_kmod-usb-wdm=y
CONFIG_PACKAGE_kmod-veth=y
CONFIG_PACKAGE_kmod-wireguard=y
CONFIG_PACKAGE_kmod-wwan=y
CONFIG_PACKAGE_kmod-zram=y
CONFIG_PACKAGE_ksmbd-server=y
CONFIG_PACKAGE_lftp=y
CONFIG_PACKAGE_libacl=m
CONFIG_PACKAGE_libaio=y
CONFIG_PACKAGE_libarchive=m
CONFIG_PACKAGE_libatomic=y
CONFIG_PACKAGE_libattr=y
CONFIG_PACKAGE_libavahi-client=y
CONFIG_PACKAGE_libavahi-dbus-support=y
CONFIG_PACKAGE_libbpf=y
CONFIG_PACKAGE_libbz2=y
CONFIG_PACKAGE_libcap=y
CONFIG_PACKAGE_libcharset=y
CONFIG_PACKAGE_libcurl=y
CONFIG_PACKAGE_libdaemon=y
CONFIG_PACKAGE_libdbus=y
CONFIG_PACKAGE_libelf=y
CONFIG_PACKAGE_libev=y
CONFIG_PACKAGE_libevdev=y
CONFIG_PACKAGE_libexpat=y
CONFIG_PACKAGE_libfdisk=y
CONFIG_PACKAGE_libffi=y
CONFIG_PACKAGE_libgcrypt=y
CONFIG_PACKAGE_libgdbm=m
CONFIG_PACKAGE_libgmp=y
CONFIG_PACKAGE_libgnutls=m
CONFIG_PACKAGE_libgpg-error=y
CONFIG_PACKAGE_libgpiod=y
CONFIG_PACKAGE_libi2c=y
CONFIG_PACKAGE_libiconv-full=y
CONFIG_PACKAGE_libiio=y
CONFIG_PACKAGE_libip4tc=y
CONFIG_PACKAGE_libip6tc=y
CONFIG_PACKAGE_libiperf3=y
CONFIG_PACKAGE_libipset=y
CONFIG_PACKAGE_libiptext=y
CONFIG_PACKAGE_libiptext-nft=y
CONFIG_PACKAGE_libiptext6=y
CONFIG_PACKAGE_libiwinfo=y
CONFIG_PACKAGE_libiwinfo-data=y
CONFIG_PACKAGE_libkmod=y
CONFIG_PACKAGE_libltdl=y
CONFIG_PACKAGE_liblua=y
CONFIG_PACKAGE_liblucihttp=y
CONFIG_PACKAGE_liblucihttp-lua=y
CONFIG_PACKAGE_liblucihttp-ucode=y
CONFIG_PACKAGE_liblzma=y
CONFIG_PACKAGE_liblzo=y
CONFIG_PACKAGE_libmagic=y
CONFIG_PACKAGE_libmbim=y
CONFIG_PACKAGE_libminiupnpc=y
CONFIG_PACKAGE_libmount=y
CONFIG_PACKAGE_libncurses=y
CONFIG_PACKAGE_libnetfilter-conntrack=y
CONFIG_PACKAGE_libnetsnmp-ssl=y
CONFIG_PACKAGE_libnettle=y
CONFIG_PACKAGE_libnfnetlink=y
CONFIG_PACKAGE_libnghttp2=y
CONFIG_PACKAGE_libnl-core=y
CONFIG_PACKAGE_libnl-genl=y
CONFIG_PACKAGE_libnl-route=y
CONFIG_PACKAGE_libnvme=y
CONFIG_PACKAGE_libopenldap=m
CONFIG_PACKAGE_libopenssl=y
CONFIG_PACKAGE_libopenssl-conf=y
CONFIG_PACKAGE_libopenssl-legacy=y
CONFIG_PACKAGE_libpcap=y
CONFIG_PACKAGE_libpci=y
CONFIG_PACKAGE_libpcre2=y
CONFIG_PACKAGE_libpopt=m
CONFIG_PACKAGE_libpython3=y
CONFIG_PACKAGE_libqmi=y
CONFIG_PACKAGE_libqrtr-glib=y
CONFIG_PACKAGE_libreadline=y
CONFIG_PACKAGE_librrd1=y
CONFIG_PACKAGE_libsasl2=m
CONFIG_PACKAGE_libseccomp=y
CONFIG_PACKAGE_libsensors=y
CONFIG_PACKAGE_libsmartcols=y
CONFIG_PACKAGE_libsqlite3=m
CONFIG_PACKAGE_libstdcpp=y
CONFIG_PACKAGE_libsysfs=y
CONFIG_PACKAGE_libtasn1=m
CONFIG_PACKAGE_libtirpc=m
CONFIG_PACKAGE_libubox-lua=y
CONFIG_PACKAGE_libubus-lua=y
CONFIG_PACKAGE_libudev-zero=y
CONFIG_PACKAGE_libugpio=y
CONFIG_PACKAGE_libupnp=y
CONFIG_PACKAGE_liburing=y
CONFIG_PACKAGE_libusb-1.0=y
CONFIG_PACKAGE_libustream-openssl=m
CONFIG_PACKAGE_libuv=y
CONFIG_PACKAGE_libwebsockets-full=y
CONFIG_PACKAGE_libxml2=y
CONFIG_PACKAGE_libxtables=y
CONFIG_PACKAGE_libzstd=y
CONFIG_PACKAGE_linuxptp=y
CONFIG_PACKAGE_lm-sensors=y
CONFIG_PACKAGE_lsblk=y
CONFIG_PACKAGE_lua=y
CONFIG_PACKAGE_lua-cjson=y
CONFIG_PACKAGE_lua-ipops=y
CONFIG_PACKAGE_luasocket=y
CONFIG_PACKAGE_luasrcdiet=y
CONFIG_PACKAGE_luci=y
CONFIG_PACKAGE_luci-app-autoreboot=y
CONFIG_PACKAGE_luci-app-cpu-perf=y
CONFIG_PACKAGE_luci-app-dawn=y
CONFIG_PACKAGE_luci-app-ddns=y
CONFIG_PACKAGE_luci-app-docker=m
CONFIG_PACKAGE_luci-app-dockerman=m
CONFIG_PACKAGE_luci-app-fakemesh=y
CONFIG_PACKAGE_luci-app-firewall=y
CONFIG_PACKAGE_luci-app-modemband=y
CONFIG_PACKAGE_luci-app-mwan3=y
CONFIG_PACKAGE_luci-app-omcproxy=y
CONFIG_PACKAGE_luci-app-package-manager=y
CONFIG_PACKAGE_luci-app-qos=y
CONFIG_PACKAGE_luci-app-radicale3=m
CONFIG_PACKAGE_luci-app-samba4=m
CONFIG_PACKAGE_luci-app-sms-tool=m
CONFIG_PACKAGE_luci-app-sqm=y
CONFIG_PACKAGE_luci-app-statistics=y
CONFIG_PACKAGE_luci-app-tailscale-community=m
CONFIG_PACKAGE_luci-app-temp-status=y
CONFIG_PACKAGE_luci-app-ttyd=y
CONFIG_PACKAGE_luci-app-upnp=y
CONFIG_PACKAGE_luci-app-usteer=y
CONFIG_PACKAGE_luci-app-wifischedule=y
CONFIG_PACKAGE_luci-base=y
CONFIG_PACKAGE_luci-compat=y
CONFIG_PACKAGE_luci-lib-base=y
CONFIG_PACKAGE_luci-lib-ip=y
CONFIG_PACKAGE_luci-lib-jsonc=y
CONFIG_PACKAGE_luci-lib-nixio=y
CONFIG_PACKAGE_luci-lib-uqr=y
CONFIG_PACKAGE_luci-light=y
CONFIG_PACKAGE_luci-lua-runtime=y
CONFIG_PACKAGE_luci-mod-admin-full=y
CONFIG_PACKAGE_luci-mod-dashboard=y
CONFIG_PACKAGE_luci-mod-network=y
CONFIG_PACKAGE_luci-mod-status=y
CONFIG_PACKAGE_luci-mod-system=y
CONFIG_PACKAGE_luci-proto-ipv6=y
CONFIG_PACKAGE_luci-proto-mbim=m
CONFIG_PACKAGE_luci-proto-modemmanager=m
CONFIG_PACKAGE_luci-proto-ppp=y
CONFIG_PACKAGE_luci-proto-qmap=m
CONFIG_PACKAGE_luci-proto-qmi=y
CONFIG_PACKAGE_luci-proto-relay=y
CONFIG_PACKAGE_luci-proto-wireguard=y
CONFIG_PACKAGE_luci-ssl=y
CONFIG_PACKAGE_luci-ssl-openssl=m
CONFIG_PACKAGE_luci-theme-bootstrap=y
CONFIG_PACKAGE_mbedtls-util=y
CONFIG_PACKAGE_minicom=y
CONFIG_PACKAGE_miniupnpc=y
CONFIG_PACKAGE_miniupnpd-iptables=y
CONFIG_PACKAGE_miniupnpd-nftables=m
CONFIG_PACKAGE_mmc-utils=y
CONFIG_PACKAGE_modemband=y
CONFIG_PACKAGE_modemmanager=y
CONFIG_PACKAGE_mt76-test=y
CONFIG_PACKAGE_mt7988-2p5g-phy-firmware=y
CONFIG_PACKAGE_mwan3=y
CONFIG_PACKAGE_nano-full=y
CONFIG_PACKAGE_natflow-auth=y
CONFIG_PACKAGE_natflow-boot=y
CONFIG_PACKAGE_natflow-hostacl=y
CONFIG_PACKAGE_nvme-cli=y
CONFIG_PACKAGE_omcproxy=y
CONFIG_PACKAGE_openssl-util=m
CONFIG_PACKAGE_partx-utils=y
CONFIG_PACKAGE_pciids=y
CONFIG_PACKAGE_pciutils=y
CONFIG_PACKAGE_ppp-mod-pppol2tp=y
CONFIG_PACKAGE_ppp-mod-pptp=y
CONFIG_PACKAGE_px5g-mbedtls=y
CONFIG_PACKAGE_python3=m
CONFIG_PACKAGE_python3-asyncio=m
CONFIG_PACKAGE_python3-base=y
CONFIG_PACKAGE_python3-certifi=m
CONFIG_PACKAGE_python3-cffi=y
CONFIG_PACKAGE_python3-chardet=m
CONFIG_PACKAGE_python3-codecs=m
CONFIG_PACKAGE_python3-cryptodome=m
CONFIG_PACKAGE_python3-cryptography=y
CONFIG_PACKAGE_python3-ctypes=y
CONFIG_PACKAGE_python3-dateutil=m
CONFIG_PACKAGE_python3-dbm=m
CONFIG_PACKAGE_python3-decimal=m
CONFIG_PACKAGE_python3-defusedxml=m
CONFIG_PACKAGE_python3-dns=m
CONFIG_PACKAGE_python3-email=y
CONFIG_PACKAGE_python3-idna=m
CONFIG_PACKAGE_python3-libpass=m
CONFIG_PACKAGE_python3-light=y
CONFIG_PACKAGE_python3-logging=m
CONFIG_PACKAGE_python3-lzma=m
CONFIG_PACKAGE_python3-markdown=m
CONFIG_PACKAGE_python3-multiprocessing=m
CONFIG_PACKAGE_python3-ncurses=m
CONFIG_PACKAGE_python3-openssl=m
CONFIG_PACKAGE_python3-packaging=m
CONFIG_PACKAGE_python3-pika=m
CONFIG_PACKAGE_python3-pkg-resources=m
CONFIG_PACKAGE_python3-ply=y
CONFIG_PACKAGE_python3-pycparser=y
CONFIG_PACKAGE_python3-pydoc=m
CONFIG_PACKAGE_python3-readline=m
CONFIG_PACKAGE_python3-requests=m
CONFIG_PACKAGE_python3-setuptools=m
CONFIG_PACKAGE_python3-six=m
CONFIG_PACKAGE_python3-sqlite3=m
CONFIG_PACKAGE_python3-unittest=m
CONFIG_PACKAGE_python3-urllib=y
CONFIG_PACKAGE_python3-urllib3=m
CONFIG_PACKAGE_python3-uuid=m
CONFIG_PACKAGE_python3-vobject=m
CONFIG_PACKAGE_python3-xml=m
CONFIG_PACKAGE_qmi-utils=m
CONFIG_PACKAGE_qos-scripts=y
CONFIG_PACKAGE_quectel-cm=m
CONFIG_PACKAGE_quectel-timesync=m
CONFIG_PACKAGE_radicale3=m
CONFIG_PACKAGE_relayd=y
CONFIG_PACKAGE_resolveip=y
CONFIG_PACKAGE_rpcd=y
CONFIG_PACKAGE_rpcd-mod-file=y
CONFIG_PACKAGE_rpcd-mod-iwinfo=y
CONFIG_PACKAGE_rpcd-mod-luci=y
CONFIG_PACKAGE_rpcd-mod-rad3-enc=m
CONFIG_PACKAGE_rpcd-mod-rrdns=y
CONFIG_PACKAGE_rpcd-mod-ucode=y
CONFIG_PACKAGE_rrdtool1=y
CONFIG_PACKAGE_runc=y
CONFIG_PACKAGE_samba4-admin=m
CONFIG_PACKAGE_samba4-client=m
CONFIG_PACKAGE_samba4-libs=m
CONFIG_PACKAGE_samba4-server=m
CONFIG_PACKAGE_samba4-utils=m
CONFIG_PACKAGE_sfdisk=y
CONFIG_PACKAGE_sms-tool=y
CONFIG_PACKAGE_snmp-utils-ssl=y
CONFIG_PACKAGE_socat=y
CONFIG_PACKAGE_sqm-scripts=y
CONFIG_PACKAGE_squashfs-tools-unsquashfs=y
CONFIG_PACKAGE_sysfsutils=y
CONFIG_PACKAGE_tailscale=m
CONFIG_PACKAGE_tc-full=y
CONFIG_PACKAGE_tcpdump=y
CONFIG_PACKAGE_terminfo=y
CONFIG_PACKAGE_tini=y
CONFIG_PACKAGE_ttyd=y
CONFIG_PACKAGE_tune2fs=y
CONFIG_PACKAGE_ucode-mod-html=y
CONFIG_PACKAGE_ucode-mod-log=y
CONFIG_PACKAGE_ucode-mod-lua=y
CONFIG_PACKAGE_ucode-mod-math=y
CONFIG_PACKAGE_ucode-mod-socket=m
CONFIG_PACKAGE_uhttpd=y
CONFIG_PACKAGE_uhttpd-mod-ubus=y
CONFIG_PACKAGE_umbim=m
CONFIG_PACKAGE_umdns=y
CONFIG_PACKAGE_uqmi=y
CONFIG_PACKAGE_urllogger=y
CONFIG_PACKAGE_usb-modeswitch=m
CONFIG_PACKAGE_usbids=y
CONFIG_PACKAGE_usbutils=y
CONFIG_PACKAGE_usteer=y
CONFIG_PACKAGE_wget-ssl=y
CONFIG_PACKAGE_wifischedule=y
CONFIG_PACKAGE_wireguard-tools=y
CONFIG_PACKAGE_wireless-tools=y
CONFIG_PACKAGE_wpad-mesh-openssl=y
CONFIG_PACKAGE_wsdd2=y
CONFIG_PACKAGE_wwan=y
CONFIG_PACKAGE_xtables-legacy=y
CONFIG_PACKAGE_xtables-nft=y
CONFIG_SAMBA4_SERVER_AVAHI=y
CONFIG_SAMBA4_SERVER_NETBIOS=y
CONFIG_SAMBA4_SERVER_VFS=y
CONFIG_SAMBA4_SERVER_WSDD2=y
CONFIG_SDK=y
CONFIG_SQLITE3_COLUMN_METADATA=y
CONFIG_SQLITE3_DYNAMIC_EXTENSIONS=y
CONFIG_SQLITE3_FTS3=y
CONFIG_SQLITE3_FTS4=y
CONFIG_SQLITE3_FTS5=y
CONFIG_SQLITE3_RTREE=y
CONFIG_SQUASHFS_TOOLS_GZIP_SUPPORT=y
CONFIG_SQUASHFS_TOOLS_LZO_SUPPORT=y
CONFIG_SQUASHFS_TOOLS_XZ_EXTENDED_SUPPORT=y
CONFIG_SQUASHFS_TOOLS_XZ_SUPPORT=y
CONFIG_SQUASHFS_TOOLS_ZSTD_SUPPORT=y
CONFIG_ZSTD_OPTIMIZE_O3=y
```
